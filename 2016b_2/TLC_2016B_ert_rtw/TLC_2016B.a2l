/******************************************************************************
* ASAP2 file: TLC_2016B.a2l
* Code generation for model "TLC_2016B".
* Model version : 1.249
* Simulink Coder version : 8.11 (R2016b) 25-Aug-2016
* C source code generated on : Tue Jul 10 12:25:03 2018
* Target selection: ert.tlc
* Embedded hardware selection: ARM Compatible->ARM Cortex
* Emulation hardware selection:
* Differs from embedded hardware (MATLAB Host)
* Code generation objectives: Unspecified
* Validation result: Not run
* (add additional file header information here)
******************************************************************************/ ASAP2_VERSION 1 31
/* Version 1.31 */
/begin PROJECT ProjectName "Project Comment Goes Here"
/begin HEADER "Header Comments go here" /end HEADER
/begin MODULE ModuleName "Module Comment Goes Here"
/begin MOD_PAR "MOD PAR Comment Goes Here" /end MOD_PAR
/begin MOD_COMMON "Mod Common Comment Here" BYTE_ORDER MSB_LAST /end MOD_COMMON
/begin RECORD_LAYOUT Scalar_BOOLEAN FNC_VALUES 1 UBYTE COLUMN_DIR DIRECT /end RECORD_LAYOUT
/begin RECORD_LAYOUT Scalar_UBYTE FNC_VALUES 1 UBYTE COLUMN_DIR DIRECT /end RECORD_LAYOUT
/begin RECORD_LAYOUT Scalar_BYTE FNC_VALUES 1 SBYTE COLUMN_DIR DIRECT /end RECORD_LAYOUT
/begin RECORD_LAYOUT Scalar_UWORD FNC_VALUES 1 UWORD COLUMN_DIR DIRECT /end RECORD_LAYOUT
/begin RECORD_LAYOUT Scalar_SWORD FNC_VALUES 1 SWORD COLUMN_DIR DIRECT /end RECORD_LAYOUT
/begin RECORD_LAYOUT Scalar_ULONG FNC_VALUES 1 ULONG COLUMN_DIR DIRECT /end RECORD_LAYOUT
/begin RECORD_LAYOUT Scalar_LONG FNC_VALUES 1 SLONG COLUMN_DIR DIRECT /end RECORD_LAYOUT
/begin RECORD_LAYOUT Scalar_FLOAT32_IEEE FNC_VALUES 1 FLOAT32_IEEE COLUMN_DIR DIRECT /end RECORD_LAYOUT
/begin RECORD_LAYOUT Scalar_FLOAT64_IEEE FNC_VALUES 1 FLOAT64_IEEE COLUMN_DIR DIRECT /end RECORD_LAYOUT
/begin RECORD_LAYOUT Lookup1D_BOOLEAN FNC_VALUES 1 UBYTE COLUMN_DIR DIRECT /end RECORD_LAYOUT
/begin RECORD_LAYOUT Lookup1D_X_BOOLEAN AXIS_PTS_X 1 UBYTE INDEX_INCR DIRECT /end RECORD_LAYOUT
/begin RECORD_LAYOUT Lookup1D_BYTE FNC_VALUES 1 SBYTE COLUMN_DIR DIRECT /end RECORD_LAYOUT
/begin RECORD_LAYOUT Lookup1D_X_BYTE AXIS_PTS_X 1 SBYTE INDEX_INCR DIRECT /end RECORD_LAYOUT
/begin RECORD_LAYOUT Lookup1D_UBYTE FNC_VALUES 1 UBYTE COLUMN_DIR DIRECT /end RECORD_LAYOUT
/begin RECORD_LAYOUT Lookup1D_X_UBYTE AXIS_PTS_X 1 UBYTE INDEX_INCR DIRECT /end RECORD_LAYOUT
/begin RECORD_LAYOUT Lookup1D_UWORD FNC_VALUES 1 UWORD COLUMN_DIR DIRECT /end RECORD_LAYOUT
/begin RECORD_LAYOUT Lookup1D_X_UWORD AXIS_PTS_X 1 UWORD INDEX_INCR DIRECT /end RECORD_LAYOUT
/begin RECORD_LAYOUT Lookup1D_WORD FNC_VALUES 1 SWORD COLUMN_DIR DIRECT /end RECORD_LAYOUT
/begin RECORD_LAYOUT Lookup1D_X_WORD AXIS_PTS_X 1 SWORD INDEX_INCR DIRECT /end RECORD_LAYOUT
/begin RECORD_LAYOUT Lookup1D_ULONG FNC_VALUES 1 ULONG COLUMN_DIR DIRECT /end RECORD_LAYOUT
/begin RECORD_LAYOUT Lookup1D_X_ULONG AXIS_PTS_X 1 ULONG INDEX_INCR DIRECT /end RECORD_LAYOUT
/begin RECORD_LAYOUT Lookup1D_SLONG FNC_VALUES 1 SLONG COLUMN_DIR DIRECT /end RECORD_LAYOUT
/begin RECORD_LAYOUT Lookup1D_X_LONG AXIS_PTS_X 1 SLONG INDEX_INCR DIRECT /end RECORD_LAYOUT
/begin RECORD_LAYOUT Lookup1D_FLOAT32_IEEE FNC_VALUES 1 FLOAT32_IEEE COLUMN_DIR DIRECT /end RECORD_LAYOUT
/begin RECORD_LAYOUT Lookup1D_X_FLOAT32_IEEE AXIS_PTS_X 1 FLOAT32_IEEE INDEX_INCR DIRECT /end RECORD_LAYOUT
/begin RECORD_LAYOUT Lookup1D_FLOAT64_IEEE FNC_VALUES 1 FLOAT64_IEEE COLUMN_DIR DIRECT /end RECORD_LAYOUT
/begin RECORD_LAYOUT Lookup1D_X_FLOAT64_IEEE AXIS_PTS_X 1 FLOAT64_IEEE INDEX_INCR DIRECT /end RECORD_LAYOUT
/begin RECORD_LAYOUT Lookup2D_BOOLEAN FNC_VALUES 1 UBYTE COLUMN_DIR DIRECT /end RECORD_LAYOUT
/begin RECORD_LAYOUT Lookup2D_X_BOOLEAN AXIS_PTS_X 1 UBYTE INDEX_INCR DIRECT /end RECORD_LAYOUT
/begin RECORD_LAYOUT Lookup2D_UBYTE FNC_VALUES 1 UBYTE COLUMN_DIR DIRECT /end RECORD_LAYOUT
/begin RECORD_LAYOUT Lookup2D_X_UBYTE AXIS_PTS_X 1 UBYTE INDEX_INCR DIRECT /end RECORD_LAYOUT
/begin RECORD_LAYOUT Lookup2D_BYTE FNC_VALUES 1 SBYTE COLUMN_DIR DIRECT /end RECORD_LAYOUT
/begin RECORD_LAYOUT Lookup2D_X_BYTE AXIS_PTS_X 1 SBYTE INDEX_INCR DIRECT /end RECORD_LAYOUT
/begin RECORD_LAYOUT Lookup2D_UWORD FNC_VALUES 1 UWORD COLUMN_DIR DIRECT /end RECORD_LAYOUT
/begin RECORD_LAYOUT Lookup2D_X_UWORD AXIS_PTS_X 1 UWORD INDEX_INCR DIRECT /end RECORD_LAYOUT
/begin RECORD_LAYOUT Lookup2D_WORD FNC_VALUES 1 SWORD COLUMN_DIR DIRECT /end RECORD_LAYOUT
/begin RECORD_LAYOUT Lookup2D_X_WORD AXIS_PTS_X 1 SWORD INDEX_INCR DIRECT /end RECORD_LAYOUT
/begin RECORD_LAYOUT Lookup2D_ULONG FNC_VALUES 1 ULONG COLUMN_DIR DIRECT /end RECORD_LAYOUT
/begin RECORD_LAYOUT Lookup2D_X_ULONG AXIS_PTS_X 1 ULONG INDEX_INCR DIRECT /end RECORD_LAYOUT
/begin RECORD_LAYOUT Lookup2D_LONG FNC_VALUES 1 SLONG COLUMN_DIR DIRECT /end RECORD_LAYOUT
/begin RECORD_LAYOUT Lookup2D_X_LONG AXIS_PTS_X 1 SLONG INDEX_INCR DIRECT /end RECORD_LAYOUT
/begin RECORD_LAYOUT Lookup2D_FLOAT32_IEEE FNC_VALUES 1 FLOAT32_IEEE COLUMN_DIR DIRECT /end RECORD_LAYOUT
/begin RECORD_LAYOUT Lookup2D_X_FLOAT32_IEEE AXIS_PTS_X 1 FLOAT32_IEEE INDEX_INCR DIRECT /end RECORD_LAYOUT
/begin RECORD_LAYOUT Lookup2D_FLOAT64_IEEE FNC_VALUES 1 FLOAT64_IEEE COLUMN_DIR DIRECT /end RECORD_LAYOUT
/begin RECORD_LAYOUT Lookup2D_X_FLOAT64_IEEE AXIS_PTS_X 1 FLOAT64_IEEE INDEX_INCR DIRECT /end RECORD_LAYOUT
/begin MEASUREMENT countSD1_E "" FLOAT64_IEEE TLC_2016B_CM_double 0 0 -1.7E+308 1.7E+308 ECU_ADDRESS 0x0000 /* @ECU_Address@countSD1_E@ */ /end MEASUREMENT
/begin MEASUREMENT lightSD1_E "" FLOAT64_IEEE TLC_2016B_CM_double 0 0 -1.7E+308 1.7E+308 ECU_ADDRESS 0x0000 /* @ECU_Address@lightSD1_E@ */ /end MEASUREMENT
/begin MEASUREMENT countSD1_N "" FLOAT64_IEEE TLC_2016B_CM_double 0 0 -1.7E+308 1.7E+308 ECU_ADDRESS 0x0000 /* @ECU_Address@countSD1_N@ */ /end MEASUREMENT
/begin MEASUREMENT lightSD1_N "" FLOAT64_IEEE TLC_2016B_CM_double 0 0 -1.7E+308 1.7E+308 ECU_ADDRESS 0x0000 /* @ECU_Address@lightSD1_N@ */ /end MEASUREMENT
/begin MEASUREMENT countSD1_S "" FLOAT64_IEEE TLC_2016B_CM_double 0 0 -1.7E+308 1.7E+308 ECU_ADDRESS 0x0000 /* @ECU_Address@countSD1_S@ */ /end MEASUREMENT
/begin MEASUREMENT lightSD1_S "" FLOAT64_IEEE TLC_2016B_CM_double 0 0 -1.7E+308 1.7E+308 ECU_ADDRESS 0x0000 /* @ECU_Address@lightSD1_S@ */ /end MEASUREMENT
/begin MEASUREMENT countSD1_W "" FLOAT64_IEEE TLC_2016B_CM_double 0 0 -1.7E+308 1.7E+308 ECU_ADDRESS 0x0000 /* @ECU_Address@countSD1_W@ */ /end MEASUREMENT
/begin MEASUREMENT lightSD1_W "" FLOAT64_IEEE TLC_2016B_CM_double 0 0 -1.7E+308 1.7E+308 ECU_ADDRESS 0x0000 /* @ECU_Address@lightSD1_W@ */ /end MEASUREMENT
/begin MEASUREMENT tag_N "" UBYTE TLC_2016B_CM_boolean 0 0 0 1 ECU_ADDRESS 0x0000 /* @ECU_Address@tag_N@ */ /end MEASUREMENT
/begin MEASUREMENT tag_S "" UBYTE TLC_2016B_CM_boolean 0 0 0 1 ECU_ADDRESS 0x0000 /* @ECU_Address@tag_S@ */ /end MEASUREMENT
/begin MEASUREMENT tag_W "" UBYTE TLC_2016B_CM_boolean 0 0 0 1 ECU_ADDRESS 0x0000 /* @ECU_Address@tag_W@ */ /end MEASUREMENT
/begin MEASUREMENT tag_E "" UBYTE TLC_2016B_CM_boolean 0 0 0 1 ECU_ADDRESS 0x0000 /* @ECU_Address@tag_E@ */ /end MEASUREMENT
/begin MEASUREMENT lgtVd_E "" UBYTE TLC_2016B_CM_boolean 0 0 0 1 ECU_ADDRESS 0x0000 /* @ECU_Address@lgtVd_E@ */ /end MEASUREMENT
/begin MEASUREMENT sensor1Value_E "" UBYTE TLC_2016B_CM_boolean 0 0 0 1 ECU_ADDRESS 0x0000 /* @ECU_Address@sensor1Value_E@ */ /end MEASUREMENT
/begin MEASUREMENT sensor1Vd_E "" UBYTE TLC_2016B_CM_boolean 0 0 0 1 ECU_ADDRESS 0x0000 /* @ECU_Address@sensor1Vd_E@ */ /end MEASUREMENT
/begin MEASUREMENT sensor2Value_E "" UBYTE TLC_2016B_CM_boolean 0 0 0 1 ECU_ADDRESS 0x0000 /* @ECU_Address@sensor2Value_E@ */ /end MEASUREMENT
/begin MEASUREMENT sensor2Vd_E "" UBYTE TLC_2016B_CM_boolean 0 0 0 1 ECU_ADDRESS 0x0000 /* @ECU_Address@sensor2Vd_E@ */ /end MEASUREMENT
/begin MEASUREMENT sensor3Value_E "" UBYTE TLC_2016B_CM_boolean 0 0 0 1 ECU_ADDRESS 0x0000 /* @ECU_Address@sensor3Value_E@ */ /end MEASUREMENT
/begin MEASUREMENT sensor3Vd_E "" UBYTE TLC_2016B_CM_boolean 0 0 0 1 ECU_ADDRESS 0x0000 /* @ECU_Address@sensor3Vd_E@ */ /end MEASUREMENT
/begin MEASUREMENT vdSD1_E "" UBYTE TLC_2016B_CM_boolean 0 0 0 1 ECU_ADDRESS 0x0000 /* @ECU_Address@vdSD1_E@ */ /end MEASUREMENT
/begin MEASUREMENT lgtVd_N "" UBYTE TLC_2016B_CM_boolean 0 0 0 1 ECU_ADDRESS 0x0000 /* @ECU_Address@lgtVd_N@ */ /end MEASUREMENT
/begin MEASUREMENT sensor1Value_N "" UBYTE TLC_2016B_CM_boolean 0 0 0 1 ECU_ADDRESS 0x0000 /* @ECU_Address@sensor1Value_N@ */ /end MEASUREMENT
/begin MEASUREMENT sensor1Vd_N "" UBYTE TLC_2016B_CM_boolean 0 0 0 1 ECU_ADDRESS 0x0000 /* @ECU_Address@sensor1Vd_N@ */ /end MEASUREMENT
/begin MEASUREMENT sensor2Value_N "" UBYTE TLC_2016B_CM_boolean 0 0 0 1 ECU_ADDRESS 0x0000 /* @ECU_Address@sensor2Value_N@ */ /end MEASUREMENT
/begin MEASUREMENT sensor2Vd_N "" UBYTE TLC_2016B_CM_boolean 0 0 0 1 ECU_ADDRESS 0x0000 /* @ECU_Address@sensor2Vd_N@ */ /end MEASUREMENT
/begin MEASUREMENT sensor3Value_N "" UBYTE TLC_2016B_CM_boolean 0 0 0 1 ECU_ADDRESS 0x0000 /* @ECU_Address@sensor3Value_N@ */ /end MEASUREMENT
/begin MEASUREMENT sensor3Vd_N "" UBYTE TLC_2016B_CM_boolean 0 0 0 1 ECU_ADDRESS 0x0000 /* @ECU_Address@sensor3Vd_N@ */ /end MEASUREMENT
/begin MEASUREMENT vdSD1_N "" UBYTE TLC_2016B_CM_boolean 0 0 0 1 ECU_ADDRESS 0x0000 /* @ECU_Address@vdSD1_N@ */ /end MEASUREMENT
/begin MEASUREMENT lgtVd_S "" UBYTE TLC_2016B_CM_boolean 0 0 0 1 ECU_ADDRESS 0x0000 /* @ECU_Address@lgtVd_S@ */ /end MEASUREMENT
/begin MEASUREMENT sensor1Value_S "" UBYTE TLC_2016B_CM_boolean 0 0 0 1 ECU_ADDRESS 0x0000 /* @ECU_Address@sensor1Value_S@ */ /end MEASUREMENT
/begin MEASUREMENT sensor1Vd_S "" UBYTE TLC_2016B_CM_boolean 0 0 0 1 ECU_ADDRESS 0x0000 /* @ECU_Address@sensor1Vd_S@ */ /end MEASUREMENT
/begin MEASUREMENT sensor2Value_S "" UBYTE TLC_2016B_CM_boolean 0 0 0 1 ECU_ADDRESS 0x0000 /* @ECU_Address@sensor2Value_S@ */ /end MEASUREMENT
/begin MEASUREMENT sensor2Vd_S "" UBYTE TLC_2016B_CM_boolean 0 0 0 1 ECU_ADDRESS 0x0000 /* @ECU_Address@sensor2Vd_S@ */ /end MEASUREMENT
/begin MEASUREMENT sensor3Value_S "" UBYTE TLC_2016B_CM_boolean 0 0 0 1 ECU_ADDRESS 0x0000 /* @ECU_Address@sensor3Value_S@ */ /end MEASUREMENT
/begin MEASUREMENT sensor3Vd_S "" UBYTE TLC_2016B_CM_boolean 0 0 0 1 ECU_ADDRESS 0x0000 /* @ECU_Address@sensor3Vd_S@ */ /end MEASUREMENT
/begin MEASUREMENT vdSD1_S "" UBYTE TLC_2016B_CM_boolean 0 0 0 1 ECU_ADDRESS 0x0000 /* @ECU_Address@vdSD1_S@ */ /end MEASUREMENT
/begin MEASUREMENT lgtVd_W "" UBYTE TLC_2016B_CM_boolean 0 0 0 1 ECU_ADDRESS 0x0000 /* @ECU_Address@lgtVd_W@ */ /end MEASUREMENT
/begin MEASUREMENT sensor1Value_W "" UBYTE TLC_2016B_CM_boolean 0 0 0 1 ECU_ADDRESS 0x0000 /* @ECU_Address@sensor1Value_W@ */ /end MEASUREMENT
/begin MEASUREMENT sensor1Vd_W "" UBYTE TLC_2016B_CM_boolean 0 0 0 1 ECU_ADDRESS 0x0000 /* @ECU_Address@sensor1Vd_W@ */ /end MEASUREMENT
/begin MEASUREMENT sensor2Value_W "" UBYTE TLC_2016B_CM_boolean 0 0 0 1 ECU_ADDRESS 0x0000 /* @ECU_Address@sensor2Value_W@ */ /end MEASUREMENT
/begin MEASUREMENT sensor2Vd_W "" UBYTE TLC_2016B_CM_boolean 0 0 0 1 ECU_ADDRESS 0x0000 /* @ECU_Address@sensor2Vd_W@ */ /end MEASUREMENT
/begin MEASUREMENT sensor3Value_W "" UBYTE TLC_2016B_CM_boolean 0 0 0 1 ECU_ADDRESS 0x0000 /* @ECU_Address@sensor3Value_W@ */ /end MEASUREMENT
/begin MEASUREMENT sensor3Vd_W "" UBYTE TLC_2016B_CM_boolean 0 0 0 1 ECU_ADDRESS 0x0000 /* @ECU_Address@sensor3Vd_W@ */ /end MEASUREMENT
/begin MEASUREMENT vdSD1_W "" UBYTE TLC_2016B_CM_boolean 0 0 0 1 ECU_ADDRESS 0x0000 /* @ECU_Address@vdSD1_W@ */ /end MEASUREMENT
/begin COMPU_METHOD /* Name of CompuMethod */ TLC_2016B_CM_double "Q = V" /* Conversion Type */ RAT_FUNC /* Format */ "%15.10" /* Units */ "" /* Coefficients */ COEFFS 0 1 0 0 0 1 /end COMPU_METHOD
/begin COMPU_METHOD /* Name of CompuMethod */ TLC_2016B_CM_boolean "Q = V" /* Conversion Type */ RAT_FUNC /* Format */ "%1.0" /* Units */ "" /* Coefficients */ COEFFS 0 1 0 0 0 1 /end COMPU_METHOD
/begin GROUP TLC_2016B "TLC_2016B" /* Root */ ROOT /begin SUB_GROUP Root_EastCan Root_NorthCan Root_SouthCan Root_WestCan /end SUB_GROUP /begin REF_MEASUREMENT tag_E tag_N tag_S tag_W /end REF_MEASUREMENT /end GROUP
/begin GROUP Root_EastCan "TLC_2016B/EastCan"
 /begin SUB_GROUP mr_grp2link_TrafficLightController_TrafficLightController_DWORK1 /end SUB_GROUP
 /begin REF_MEASUREMENT countSD1_E lgtVd_E lightSD1_E sensor1Value_E sensor1Vd_E sensor2Value_E sensor2Vd_E sensor3Value_E sensor3Vd_E vdSD1_E /end REF_MEASUREMENT
/end GROUP
/begin GROUP Root_NorthCan "TLC_2016B/NorthCan"
 /begin SUB_GROUP mr_grp2link_TrafficLightController_TrafficLightController_DWORK1_m /end SUB_GROUP
 /begin REF_MEASUREMENT countSD1_N lgtVd_N lightSD1_N sensor1Value_N sensor1Vd_N sensor2Value_N sensor2Vd_N sensor3Value_N sensor3Vd_N vdSD1_N /end REF_MEASUREMENT
/end GROUP
/begin GROUP Root_SouthCan "TLC_2016B/SouthCan"
 /begin SUB_GROUP mr_grp2link_TrafficLightController_TrafficLightController_DWORK1_d /end SUB_GROUP
 /begin REF_MEASUREMENT countSD1_S lgtVd_S lightSD1_S sensor1Value_S sensor1Vd_S sensor2Value_S sensor2Vd_S sensor3Value_S sensor3Vd_S vdSD1_S /end REF_MEASUREMENT
/end GROUP
/begin GROUP Root_WestCan "TLC_2016B/WestCan"
 /begin SUB_GROUP mr_grp2link_TrafficLightController_TrafficLightController_DWORK1_i /end SUB_GROUP
 /begin REF_MEASUREMENT countSD1_W lgtVd_W lightSD1_W sensor1Value_W sensor1Vd_W sensor2Value_W sensor2Vd_W sensor3Value_W sensor3Vd_W vdSD1_W /end REF_MEASUREMENT
/end GROUP
/end MODULE
/end PROJECT
/* (add any file trailer comments here) */
/* EOF TLC_2016B.a2l */
